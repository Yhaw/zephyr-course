## boards/nrf9151_scratch/Kconfig.defconfig
```kconfig
# nRF9151 Scratch board default configuration

config HW_STACK_PROTECTION
	default ARCH_HAS_STACK_PROTECTION
```

## boards/nrf9151_scratch/Kconfig.nrf9151_scratch
```kconfig
# nRF9151 Scratch board configuration

config BOARD_NRF9151_SCRATCH
	select SOC_NRF9151_LACA
```

## boards/nrf9151_scratch/board.yml
```yaml
board:
  name: nrf9151_scratch
  full_name: nRF9151 Scratch Board
  vendor: custom
  socs:
  - name: nrf9151
```

## boards/nrf9151_scratch/nrf9151_scratch_nrf9151_defconfig
```kconfig
# Enable MPU
CONFIG_ARM_MPU=y

# Enable TrustZone-M
CONFIG_ARM_TRUSTZONE_M=y

# Enable GPIO
CONFIG_GPIO=y

# Enable UART driver and console
CONFIG_SERIAL=y
CONFIG_CONSOLE=y
CONFIG_UART_CONSOLE=y
```

## boards/nrf9151dk_custom/Kconfig.nrf9151dk_custom
```kconfig
# nRF9151 DK Custom board configuration

config BOARD_NRF9151DK_CUSTOM
	select SOC_NRF9151_LACA
```

## boards/nrf9151dk_custom/board.yml
```yaml
board:
  name: nrf9151dk_custom
  full_name: nRF9151 DK Custom
  vendor: custom
  socs:
  - name: nrf9151
    variants:
    - name: 'ns'
```

## drivers/led_sensor/Kconfig
```kconfig
menuconfig LED_SENSOR
	bool "Custom LED Sensor Driver"
	default y
	depends on DT_HAS_CUSTOM_LED_SENSOR_ENABLED
	select SENSOR
	select GPIO
	help
	  Enable custom sensor driver that controls an on-board LED.
```

## dts/bindings/sensor/custom,led-sensor.yaml
```yaml
description: Custom LED Sensor Driver
compatible: "custom,led-sensor"

properties:
  led-gpios:
    type: phandle-array
    required: true
    description: GPIO pin connected to the LED
```
